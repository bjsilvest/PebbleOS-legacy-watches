## boards/qemu_silk/Kconfig.defconfig
```kconfig
# SPDX-FileCopyrightText: 2026 Brian Silvestri
# SPDX-License-Identifier: Apache-2.0

config QEMU_MACHINE
    default "pebble-flint"

config RESOURCES_BOARD
    default "qemu_silk"
```

## boards/silk/Kconfig
```kconfig
# SPDX-FileCopyrightText: 2026 Brian Silvestri
# SPDX-License-Identifier: Apache-2.0

config BOARD_SILK
    bool
    default y
```

## boards/snowy/Kconfig
```kconfig
# SPDX-FileCopyrightText: 2026 Brian Silvestri
# SPDX-License-Identifier: Apache-2.0

config BOARD_SNOWY
    bool
    default y
```

## boards/snowy/Kconfig.s3
```kconfig
# SPDX-FileCopyrightText: 2026 Brian Silvestri
# SPDX-License-Identifier: Apache-2.0

config BOARD_SNOWY_S3
    bool
    default y
```

## boards/spalding/Kconfig
```kconfig
# SPDX-FileCopyrightText: 2026 Brian Silvestri
# SPDX-License-Identifier: Apache-2.0

config BOARD_SPALDING
    bool
    default y
```

## boards/tintin/Kconfig.bb2
```kconfig
# SPDX-FileCopyrightText: 2026 Brian Silvestri
# SPDX-License-Identifier: Apache-2.0

config BOARD_TINTIN_BB2
    bool
    default y
    select IS_BIGBOARD
```

## boards/tintin/Kconfig.defconfig.v1_5
```kconfig
# SPDX-FileCopyrightText: 2026 Brian Silvestri
# SPDX-License-Identifier: Apache-2.0

config BUNDLE_HWREV
    default "v1_5"
```

## boards/tintin/Kconfig.ev2_4
```kconfig
# SPDX-FileCopyrightText: 2026 Brian Silvestri
# SPDX-License-Identifier: Apache-2.0

config BOARD_TINTIN_EV2_4
    bool
    default y
```

## boards/tintin/Kconfig.v1_5
```kconfig
# SPDX-FileCopyrightText: 2026 Brian Silvestri
# SPDX-License-Identifier: Apache-2.0

config BOARD_TINTIN_V1_5
    bool
    default y
```

## drivers/ambient/Kconfig
```kconfig
# SPDX-FileCopyrightText: 2026 Core Devices LLC
# SPDX-License-Identifier: Apache-2.0

menuconfig AMBIENT_LIGHT
    bool "Ambient Light Sensor"
    help
      Ambient light sensor drivers (pbl/drivers/als.h). The board
      instantiates the sensor it has and exports it as ALS.

if AMBIENT_LIGHT

config AMBIENT_LIGHT_OPT3001
    bool "TI OPT3001"
    depends on I2C
    help
      Support for the TI OPT3001 ambient light sensor.

config AMBIENT_LIGHT_W1160
    bool "W1160"
    depends on I2C
    help
      Support for the W1160 ambient light sensor.

config AMBIENT_LIGHT_STM32_ADC
    bool "Analog sensor on the STM32 ADC"
    depends on SOC_STM32F4
    help
      Photodiode read through ADC1 against VREFINT, powered by a GPIO
      (silk).

config AMBIENT_LIGHT_THRESHOLD_LOCAL
    bool "Keep the dark threshold off the phone sync"
    help
      Do not sync the backlight's ambient light threshold with the phone,
      and drop a stored one once. For sensors whose scale differs a lot
      from other watches (the original Pebble's reads ~235 in the dark), so
      a value synced from another watch model cannot keep the backlight off.

config AMBIENT_LIGHT_LUX_TABLE
    bool "Convert levels to lux with a board table"
    depends on AMBIENT_LIGHT_STM32_ADC
    help
      Convert raw levels to lux by interpolating between calibration points
      in the sensor's pbl_als_scale table, for a sensor whose response
      is far from linear (a phototransistor that flattens out in bright
      light), instead of the linear offset/num/den conversion.

config AMBIENT_LIGHT_QEMU
    bool "QEMU"
    default y if SOC_QEMU
    help
      QEMU ambient light sensor. QEMU emulates none, so it always reads
      complete darkness.

config AMBIENT_LIGHT_POSIX
    bool "POSIX"
    default y if SOC_POSIX
    help
      Ambient light driver for a native build (always dark).

config AMBIENT_LIGHT_BITS
    int "Ambient light sensor resolution (bits)"
    default 12 if AMBIENT_LIGHT_OPT3001
    default 16 if AMBIENT_LIGHT_W1160
    default 12 if AMBIENT_LIGHT_QEMU
    default 12 if AMBIENT_LIGHT_STM32_ADC
    default 12 if AMBIENT_LIGHT_POSIX
    help
      Number of bits in the ambient light sensor reading. Used to derive
      AMBIENT_LIGHT_LEVEL_MAX, which bounds the dark/backlight thresholds
      exposed to the shell and settings UI.

module = DRIVER_AMBIENT
module-str = Ambient Light Sensor
source "subsys/logging/Kconfig.template.log_level"

endif # AMBIENT_LIGHT
```

## drivers/battery/Kconfig
```kconfig
# SPDX-FileCopyrightText: 2026 Core Devices LLC
# SPDX-License-Identifier: Apache-2.0

menuconfig BATTERY
    bool "Battery"
    help
      Battery Drivers

if BATTERY

config BATTERY_PMIC
    bool "PMIC-based"
    help
      Battery management via external PMIC. Used on platforms where the
      PMIC handles battery monitoring (asterix, obelix, getafix).

config BATTERY_GPIO_ADC
    bool "Charger GPIOs and ADC"
    depends on SOC_STM32F4
    help
      Battery without a PMIC: USB power and charging status on GPIOs and
      the battery voltage on the ADC (the original Pebble).

config BATTERY_QEMU
    bool "QEMU Battery"
    default y if SOC_QEMU
    help
      Stub battery driver for QEMU (fixed values).

config BATTERY_POSIX
    bool "POSIX Battery"
    default y if SOC_POSIX
    help
      Battery driver for a native build (fixed values).

endif # BATTERY
```

## drivers/bluetooth/Kconfig
```kconfig
# SPDX-FileCopyrightText: 2026 Brian Silvestri
# SPDX-License-Identifier: Apache-2.0

config BT_CONTROLLER_DA1468X
    bool "DA1468x controller booted from RAM"
    depends on SOC_STM32F4 && BT_HCI_UART
    help
      Boot a Dialog DA1468x as the H4 HCI controller. Its bootrom loads a
      small stage 2 over UART, which then receives the controller image at
      1 Mbaud. Both images run from the radio's RAM; nothing is written to
      its non-volatile memory.

      The images are built outside this tree from the Dialog SDK, which may
      not be redistributed, and embedded from the paths below. See
      docs/boards/silk.

if BT_CONTROLLER_DA1468X

config BT_DA1468X_STAGE2_IMAGE
    string "Stage 2 image"
    help
      Absolute path to the stage 2 loader binary.

config BT_DA1468X_CONTROLLER_IMAGE
    string "Controller image"
    help
      Absolute path to the HCI controller binary.

config BT_DA1468X_HCI_BAUD
    int "HCI baud rate"
    default 115200
    help
      Baud rate of the controller image's H4 UART.

endif

config BT_CONTROLLER_CC2564
    bool "TI CC2564 controller"
    depends on SOC_STM32F4 && BT_HCI_UART
    help
      Power up a TI CC2564 as the H4 HCI controller and load TI's
      initialization script (third_party/ti_bt_sp), which it needs at every
      power up. The board provides BOARD_BT_SHUTDOWN, BOARD_BT_CTS and
      BOARD_MCO1 for its 32 kHz slow clock.

config BT_CC2564_BTS_RESOURCE
    bool "Init script from the system resources"
    depends on BT_CONTROLLER_CC2564
    help
      Read TI's initialization script from the BT_INIT_SCRIPT system
      resource, which the board's resource map provides, instead of
      building TIInit_6.7.16.bts into the firmware. For boards with little
      internal flash and another script (the CC2564A's is 24 KB).

config BT_CC2564_HCI_BAUD
    int "HCI baud rate"
    depends on BT_CONTROLLER_CC2564
    default 921600
    help
      Baud rate the controller is switched to after power up.

config BT_CC2564_SLEEP
    bool "CC2564 deep sleep (eHCILL)"
    depends on BT_CONTROLLER_CC2564
    help
      Let the controller deep sleep with TI's eHCILL protocol (SWRA288)
      and the host enter STOP mode meanwhile. Without it the controller
      never sleeps and STOP is blocked while Bluetooth runs.

config BT_CONTROLLER_DIAGNOSTICS
    bool "Controller bring-up diagnostics"
    depends on BT_CONTROLLER_DA1468X || BT_CONTROLLER_CC2564
    default y
    help
      Keep pairing, SMP, app fetch and controller start-up traces and show
      them in Settings > System > Information, along with the last reboot
      reason. For bringing up a port; not something to ship upstream.

config BT_CC2564_SLEEP_NO_STOP
    bool "Keep the host out of STOP while the controller sleeps"
    depends on BT_CC2564_SLEEP
    help
      The controller still deep sleeps, but STOP stays blocked while
      Bluetooth runs, in case STOP stops MCO1, the controller's slow clock.
      For testing the two apart.

config BT_HCI_UART_STACK_SIZE
    int "HCI UART thread stack size in bytes"
    default 2048 if BT_CONTROLLER_DA1468X || BT_CONTROLLER_CC2564
    default 1024
    help
      Booting the DA1468X or CC2564 controller also runs on this thread,
      so those need the larger stack.
```

## drivers/display/Kconfig
```kconfig
# SPDX-FileCopyrightText: 2026 Core Devices LLC
# SPDX-License-Identifier: Apache-2.0

menuconfig DISPLAY
    bool "Display"
    help
      Display Drivers

if DISPLAY

config DISPLAY_SF32LB_LCDC
    bool "SiFli SF32LB LCD controller"
    default y if SOC_SF32LB52
    depends on CLK_SF32LB && PINCTRL && RESET_SF32LB
    select PANEL
    help
      Support for the SiFli SF32LB LCD controller, driving a JDI
      memory-in-pixel panel.

config DISPLAY_SHARP_LS013B7DH01
    bool "Sharp LS013B7DH01"
    default y if SOC_NRF52
    depends on PWM && SPI
    help
      Support for the Sharp LS013B7DH01 memory LCD.

config DISPLAY_SHARP_LS013B7DH01_STM32
    bool "Sharp LS013B7DH01 (STM32)"
    depends on SOC_STM32F4
    default y if HAL_STM32_STM32F412 || SOC_STM32F205
    help
      Support for the Sharp LS013B7DH01 display on an STM32F2/F4 SPI.

config DISPLAY_ICE40LP_STM32
    bool "iCE40LP framebuffer FPGA (STM32)"
    depends on SOC_STM32F4
    default y if HAL_STM32_STM32F439
    help
      Support for the Pebble Time display, driven through an iCE40LP
      framebuffer FPGA on an STM32F4 SPI.

config DISPLAY_QEMU
    bool "QEMU Framebuffer Display"
    default y if SOC_QEMU
    help
      Support for the QEMU framebuffer display peripheral.

config DISPLAY_SDL
    bool "SDL window"
    default y if SOC_POSIX
    select SDL
    help
      Display shown in an SDL window on the host of a native build.

config DISPLAY_SHELL
    bool "Shell commands"
    default y
    depends on SHELL
    help
      The display shell command, to show the display and turn its panel on
      or off.

module = DRIVER_DISPLAY
module-str = Display
source "subsys/logging/Kconfig.template.log_level"

endif # DISPLAY
```

## drivers/exti/Kconfig
```kconfig
# SPDX-FileCopyrightText: 2026 Core Devices LLC
# SPDX-License-Identifier: Apache-2.0

menuconfig EXTI
    bool "External Interrupt"
    help
      External Interrupt Drivers

if EXTI

config EXTI_STM32
    bool "ST STM32"
    default y if SOC_STM32F4
    select HAL_STM32
    help
      Support for the STM32F4 external interrupt controller.

module = DRIVER_EXTI
module-str = External Interrupt
source "subsys/logging/Kconfig.template.log_level"

endif # EXTI
```

## drivers/flash/Kconfig
```kconfig
# SPDX-FileCopyrightText: 2026 Core Devices LLC
# SPDX-License-Identifier: Apache-2.0

menuconfig FLASH
    bool "Flash"
    help
      Flash Drivers

if FLASH

config FLASH_GD25LQ255E
    bool "GigaDevice GD25LQ255E"
    help
      Support for the GigaDevice GD25LQ255E NOR flash.

config FLASH_GD25Q256E
    bool "GigaDevice GD25Q256E"
    help
      Support for the GigaDevice GD25Q256E NOR flash.

config FLASH_MX25U
    bool "Macronix MX25U (QSPI)"
    depends on SOC_STM32F4
    help
      Support for the Macronix MX25U64 NOR flash on the STM32F412
      QUADSPI, as found on the Pebble 2 (silk).

config FLASH_N25Q
    bool "Micron N25Q (SPI)"
    depends on SOC_STM32F4
    help
      Micron N25Q032 or N25Q064 SPI NOR of the original Pebble, on a plain
      SPI bus.

config FLASH_S29VS
    bool "Spansion S29VS (FMC)"
    depends on HAL_STM32_STM32F439
    help
      Support for the Spansion S29VS parallel NOR flash on the STM32F439
      FMC, as found on the Pebble Time (snowy).

config FLASH_QEMU
    bool "QEMU External Flash"
    default y if SOC_QEMU
    help
      Support for the QEMU external flash peripheral.

config FLASH_POSIX
    bool "POSIX External Flash"
    default y if SOC_POSIX
    help
      External flash backed by a file on the host.

config FLASH_LAYOUT_SILK
    bool "Pebble 2 (silk) stock flash layout"
    select FLASH_GUARD
    help
      Use the stock Pebble 2 external flash layout, keeping the stock
      bootloader's PRF, shared PRF storage and MFG info where they are.

config FLASH_LAYOUT_TINTIN
    bool "Original Pebble (tintin) stock flash layout"
    select FLASH_GUARD
    help
      Use the stock original Pebble external flash layout, keeping the stock
      bootloader's firmware scratch, PRF, shared PRF storage and factory
      registry where they are.

config FLASH_LAYOUT_TINTIN_8MB
    bool "8 MiB flash"
    depends on FLASH_LAYOUT_TINTIN
    help
      The 8 MiB N25Q064 of the retail original Pebble (v1_5) and the Pebble
      Steel (v2_0). As in the stock firmware, the 2 MiB past the 4 MiB layout
      is a filesystem region, and the 2 MiB after it go unused.

config FLASH_LAYOUT_SNOWY
    bool "Pebble Time (snowy) stock flash layout"
    select FLASH_GUARD
    help
      Use the stock Pebble Time external flash layout, keeping the stock
      bootloader's PRF, shared PRF storage and MFG info (with the boot FPGA
      bitstream) where they are.

config FLASH_GUARD
    bool "Guard regions the firmware does not own"
    help
      Assert instead of issuing any erase or write that overlaps PRF,
      shared PRF storage or MFG info, and refuse security register writes.

module = DRIVER_FLASH
module-str = Flash
source "subsys/logging/Kconfig.template.log_level"

endif # FLASH
```

## drivers/hrm/Kconfig
```kconfig
# SPDX-FileCopyrightText: 2026 Core Devices LLC
# SPDX-License-Identifier: Apache-2.0

menuconfig HRM
    bool "Heart Rate Monitor"
    help
      Heart Rate Monitor Drivers

if HRM

config HRM_GH3X2X
    bool "Goodix GH3X2X"
    help
      Support for the Goodix GH3X2X heart rate sensor.

config HRM_AS7000
    bool "ams AS7000"
    depends on SOC_STM32F4
    help
      Support for the ams AS7000 heart rate sensor of the Pebble 2 HR. Uses
      the application already in the sensor flash and reports heart rate
      only. The sensor is probed at boot, so the Pebble 2 SE runs the same
      firmware.

config HRM_AS7000_HRV
    bool "AS7000 HRV (PRV application)"
    depends on HRM_AS7000
    select HRM_HRV
    help
      While an app asks for HRV, ask the sensor to run its undocumented PRV
      (pulse rate variability) application next to HRM, as the Pebble
      Time 2 runs HRV only while an app asks. Falls back to HRM alone if
      the sensor does not start with PRV. Never writes the sensor flash.
      With PRV running the LEDs pulse too fast to see flicker, so they
      look solid. Apps get no HRV data yet: the PRV results are not
      decoded.

config HRM_AS7000_PRV_PROBE
    bool "AS7000 PRV probe (diagnostic)"
    depends on HRM_AS7000_HRV
    help
      Record the registers around the PPG block at each handshake, for
      Settings > System > Information and app logs, to work out the PRV
      results. The Information row can also ask for HRV itself.

config HRM_SPO2
    bool
    default y if HRM_GH3X2X || HRM_QEMU
    help
      The sensor measures blood oxygen (SpO2). Without it the blood oxygen
      settings are neither shown nor synced with the phone, and the HRM
      manager never asks for SpO2.

config HRM_HRV
    bool "HRV (RR interval) support"
    depends on HRM_GH3X2X || HRM_AS7000_HRV
    default n
    help
      Expose heart-rate-variability (RR/inter-beat interval) data from the
      HRM sensor. On the GH3x2x, enables the Goodix HRV algorithm and links
      the nonfree HRV library. Off by default; HRV is only sampled while an
      app holds an HRV subscription.

config HRM_QEMU
    bool "QEMU"
    default y if SOC_QEMU
    help
      QEMU heart rate monitor. QEMU emulates none, so it can be enabled
      but never delivers samples.

module = DRIVER_HRM
module-str = Heart Rate Monitor
source "subsys/logging/Kconfig.template.log_level"

endif # HRM
```
