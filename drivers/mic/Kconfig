## drivers/mic/Kconfig
```kconfig
# SPDX-FileCopyrightText: 2026 Core Devices LLC
# SPDX-License-Identifier: Apache-2.0

menuconfig MIC
    bool "Microphone"
    help
      Microphone Drivers

if MIC

config MIC_NRF5
    bool "Nordic nRF5 PDM"
    default y if SOC_NRF52
    select HAL_NORDIC
    help
      Support for the Nordic nRF5 PDM microphone interface.

config MIC_SF32LB
    bool "SiFli SF32LB PDM"
    default y if SOC_SF32LB52
    select HAL_SIFLI
    select HAL_SIFLI_AUDCODEC
    select HAL_SIFLI_PDM
    select MIC_POLLING
    help
      Support for the SiFli SF32LB PDM microphone interface.

config MIC_STM32_DFSDM
    bool "STM32 DFSDM"
    depends on SOC_STM32F4
    help
      PDM microphone through the STM32F412 DFSDM (silk).

config MIC_STM32_I2S_PDM
    bool "STM32 I2S PDM"
    depends on SOC_STM32F4
    help
      PDM microphone through an STM32F4 SPI in I2S mode, decimated by the
      OpenPDMFilter (snowy).

config MIC_QEMU
    bool "QEMU stub"
    default y if SOC_QEMU || SOC_POSIX
    help
      Software-only microphone for QEMU and native builds. Delivers audio the
      host sends over the QEMU channel (`pebble emu-mic`) at MIC_SAMPLE_RATE,
      and silence when there is none.

config MIC_POLLING
    bool
    help
      The driver implements mic_start_polling(), mic_poll() and
      mic_get_frame_time().

module = DRIVER_MIC
module-str = Microphone
source "subsys/logging/Kconfig.template.log_level"

endif # MIC
```

## drivers/pmic/Kconfig
```kconfig
# SPDX-FileCopyrightText: 2026 Core Devices LLC
# SPDX-License-Identifier: Apache-2.0

menuconfig PMIC
    bool "PMIC"
    help
      PMIC Drivers

if PMIC

config PMIC_NPM1300
    bool "Nordic nPM1300 charger"
    default y
    depends on MFD_NPM1300
    help
      Support for the charger of the Nordic nPM1300 PMIC.

config PMIC_MAX14690
    bool "Maxim MAX14690"
    depends on SOC_STM32F4 && I2C
    help
      Support for the Maxim MAX14690 PMIC on snowy: charger, LDO2 for the
      display FPGA and battery voltage measurement through its MON output.
      Charger settings are the stock firmware's.

config PMIC_AS3701B
    bool "ams AS3701B"
    depends on SOC_STM32F4 && I2C
    help
      Support for the ams AS3701B PMIC on silk: charger, rails, display
      VCOM clock and battery voltage measurement. Charger settings are
      the stock firmware's.

module = DRIVER_PMIC
module-str = PMIC
source "subsys/logging/Kconfig.template.log_level"

endif # PMIC
```

## drivers/rtc/Kconfig
```kconfig
# SPDX-FileCopyrightText: 2026 Core Devices LLC
# SPDX-License-Identifier: Apache-2.0

menuconfig RTC
    bool "RTC"
    help
      RTC Drivers

if RTC

config RTC_NRF5
    bool "Nordic nRF5"
    default y if SOC_NRF52
    select HAL_NORDIC
    help
      Support for the Nordic nRF5 RTC.

config RTC_SF32LB
    bool "SiFli SF32LB"
    default y if SOC_SF32LB52
    select HAL_SIFLI
    select HAL_SIFLI_LRC_CAL
    select HAL_SIFLI_RTC
    help
      Support for the SiFli SF32LB RTC.

config RTC_STM32
    bool "ST STM32"
    default y if SOC_STM32F4 && !SOC_STM32F205
    select HAL_STM32
    help
      Support for the STM32F4 RTC.

config RTC_STM32F2
    bool "ST STM32F2"
    default y if SOC_STM32F205
    select HAL_STM32
    help
      Support for the STM32F2 RTC, run in the stock fast mode (the F2 has no
      sub-second register).

config RTC_QEMU
    bool "QEMU RTC"
    default y if SOC_QEMU
    help
      Support for the QEMU RTC peripheral.

config RTC_POSIX
    bool "POSIX RTC"
    default y if SOC_POSIX
    help
      RTC following the host clock.

module = DRIVER_RTC
module-str = RTC
source "subsys/logging/Kconfig.template.log_level"

endif # RTC
```

## fw/Kconfig
```kconfig
# SPDX-FileCopyrightText: 2026 Core Devices LLC
# SPDX-License-Identifier: Apache-2.0

rsource "apps/Kconfig"
rsource "kernel/Kconfig"
rsource "services/Kconfig"

menu "Software Features"

config SETTINGS_ICONS
    bool "Settings menu icons"
    help
      Show icons next to entries in the system Settings menu.

config THEMING
    bool "Color theming"
    help
      Expose the highlight-color theming UI under Settings.

config BACKLIGHT_STANDARD_INTENSITY
    int "Standard backlight preset intensity (%)"
    range 1 100
    default 50
    help
      Logical brightness used by the Standard backlight preset and fresh
      shell preferences. The light service scales it to the board hardware
      maximum. Saved brightness preferences take precedence.

config DYNAMIC_BACKLIGHT
    bool "Dynamic backlight"
    help
      Adjust backlight intensity based on ambient light readings.
      Requires an ambient light sensor.

config ACCEL_SENSITIVITY
    bool "Accelerometer sensitivity setting"
    help
      Expose the accelerometer tap/shake sensitivity adjustment in
      Settings.

config APP_SCALING
    bool "App scaling"
    help
      Scale legacy lower-resolution apps to the current display via
      the compositor.

config ORIENTATION_MANAGER
    bool "Orientation manager UI"
    help
      Expose the device-orientation / rotation prefs in shell and
      Settings. Independent of CONFIG_SERVICE_ORIENTATION_MANAGER,
      which controls whether the underlying service is built.

config MODDABLE_XS
    bool "Moddable XS JavaScript engine"
    depends on USERSPACE
    help
      Build Moddable XS support for running JavaScript apps. PRF
      variant builds force this off regardless of the board default.

config MMAP_RESOURCES
    bool "Memory-mapped (zero-copy) resource reads"
    help
      Serve read-only system resources as direct pointers into
      memory-mapped flash instead of copying them out.

config FIRMWARE_LEGACY_CRC
    bool "Firmware descriptions use the legacy STM32 CRC"
    depends on !PBLBOOT
    help
      The checksum in a firmware image's description (in flash, ahead of
      the image) is the legacy STM32 CRC, not CRC32, as the stock
      bootloader and recovery firmware of older watches (snowy) expect.
      Used to check the recovery image and to write staged updates.

config FIRMWARE_NEW_WORLD_MARKER
    bool "Mark the vector table for the original Pebble's bootloader"
    depends on !PBLBOOT
    help
      Put "NeWo" (0x4E65576F) in the reserved vector table word at offset
      28. The stock tintin bootloader only boots, and only installs, an
      image at 0x08004000 when it finds the marker there.

endmenu

choice
    prompt "Shell"
    default SHELL_NORMAL

config SHELL_NORMAL
    bool "Normal shell"

config SHELL_SDK
    bool "SDK shell"
    help
      Use the SDK shell instead of the normal shell.

endchoice

menu "Debug & instrumentation"

config QEMU_SERIAL
    bool "QEMU serial protocol"
    default y if QEMU
    help
      The Pebble protocol and the emulator's controls (battery, taps,
      time format, ...) over the board's QEMU_UART, framed as libpebble2's
      QEMU transport expects.

config NO_WATCH_TIMEOUT
    bool "Disable watchface idle timeout"

config UI_DEBUG
    bool "UI debug commands"
    help
      Enable the window dump and layer nudge CLI commands.

config MALLOC_INSTRUMENTATION
    bool "Malloc instrumentation"
    help
      Track the caller PC of every heap allocation.

config ADVANCED_LOGGING_BUFFER_SIZE
    int "Flash log buffer size"
    default 1200
    help
      RAM that collects log lines until they are written to flash. Hashed
      lines are 30-80 bytes, so 1200 holds 15-40 of them.

config PROFILER
    bool "Profiler"

config PERFORMANCE_TESTS
    bool "Performance test instrumentation"
    select PROFILER

endmenu
```

## fw/apps/Kconfig
```kconfig
# SPDX-FileCopyrightText: 2026 Core Devices LLC
# SPDX-License-Identifier: Apache-2.0

menu "Applications"

config LAUNCHER_LEGACY
    bool
    default y if !SERVICE_APP_GLANCES
    help
      The plain app list of the original Pebble, used when there are no
      app glances.

config APP_SPORTS
    bool "Sports app"
    default y
    help
      The Sports app, which phone apps drive through the PebbleKit Sports
      API to show time, distance and pace on the watch.

rsource "demo/Kconfig"
rsource "watch/Kconfig"

endmenu
```

## fw/kernel/Kconfig
```kconfig
# SPDX-FileCopyrightText: 2026 Core Devices LLC
# SPDX-License-Identifier: Apache-2.0

config CORE_DUMP
    bool "Core dumps"
    default y
    depends on !ARCH_POSIX
    help
      On a crash, save the memory and register state to flash for later
      retrieval. Without it the watch only resets; the reboot reason still
      records the faulting address.

config TASK_TIMER_POOL_SIZE
    int "TaskTimer slab pool size"
    default 192
    help
      Number of TaskTimer slots reserved in .kernel_bss
```

## fw/services/analytics/Kconfig
```kconfig
# SPDX-FileCopyrightText: 2026 Core Devices LLC
# SPDX-License-Identifier: Apache-2.0

config SERVICE_ANALYTICS
    bool "Analytics"
    help
      Firmware analytics and telemetry.

if SERVICE_ANALYTICS

config SERVICE_ANALYTICS_NATIVE
    bool "Native backend"
    default y
    help
      Hourly heartbeats collected and logged by the firmware. Without a
      backend every analytics call is a no-op.

config SERVICE_ANALYTICS_SYSTEM_STATS
    bool "Task, stack, heap and filesystem statistics"
    depends on SERVICE_ANALYTICS_NATIVE
    default y
    help
      Collect per-task CPU time, free stack, kernel heap and filesystem
      usage in the heartbeat. Without it those metrics are left at 0.

module = SERVICE_ANALYTICS
module-str = Analytics
source "subsys/logging/Kconfig.template.log_level"

endif
```

## fw/services/imaging/Kconfig
```kconfig
# SPDX-FileCopyrightText: 2026 Brian Silvestri
# SPDX-License-Identifier: Apache-2.0

config SERVICE_IMAGING_PICTURES
    bool "Album art and notification pictures"
    depends on SCREEN_COLOR_DEPTH_BITS_8
    default y if PLATFORM_EMERY || PLATFORM_GABBRO
    help
      Show album art in the music app and pictures in notifications, fetched
      from the phone through the imaging endpoint at the watch's size, 4 bits
      per pixel. Needs a color display, and room in the kernel heap for one
      decoded image at a time; an image that does not fit is dropped and the
      text-only layout shown.
```

## fw/services/new_timer/Kconfig
```kconfig
# SPDX-FileCopyrightText: 2026 Core Devices LLC
# SPDX-License-Identifier: Apache-2.0

config SERVICE_NEW_TIMER
    bool "New timer"
    help
      Legacy "new" timer service.

if SERVICE_NEW_TIMER

config SERVICE_NEW_TIMER_STACK_SIZE
    int "New timer thread stack size in bytes"
    default 1380

module = SERVICE_NEW_TIMER
module-str = New timer
source "subsys/logging/Kconfig.template.log_level"

endif
```

## fw/services/put_bytes/Kconfig
```kconfig
# SPDX-FileCopyrightText: 2026 Core Devices LLC
# SPDX-License-Identifier: Apache-2.0

config SERVICE_PUT_BYTES
    bool "Put bytes"
    help
      put_bytes endpoint (incoming binary transfer).

if SERVICE_PUT_BYTES

config SERVICE_PUT_BYTES_BUFFERS
    int "Put bytes chunk buffers"
    range 2 3
    default 3
    help
      Kernel heap buffers of about 2 KiB that a transfer holds to acknowledge
      chunks before they are written. A board with a small kernel heap can
      keep fewer, so other allocations don't fail during a transfer.

module = SERVICE_PUT_BYTES
module-str = Put bytes
source "subsys/logging/Kconfig.template.log_level"

endif
```

## fw/services/shared_prf_storage/Kconfig
```kconfig
# SPDX-FileCopyrightText: 2026 Core Devices LLC
# SPDX-License-Identifier: Apache-2.0

config SERVICE_SHARED_PRF_STORAGE
    bool "Shared PRF storage"
    help
      Shared storage used by the PRF (recovery) firmware.

if SERVICE_SHARED_PRF_STORAGE

config SERVICE_SHARED_PRF_STORAGE_IMPORT_STOCK
    bool "Import the stock firmware's shared PRF storage"
    depends on RNG
    help
      On boards whose recovery firmware is the stock one, which keeps its own
      shared PRF storage (FLASH_REGION_STOCK_SHARED_PRF_STORAGE), copy that
      entry into ours when our identity root key differs from it. The phone
      then sees one watch, with the same address and bonding, in both
      firmwares. The stock region is only read.

module = SERVICE_SHARED_PRF_STORAGE
module-str = Shared PRF storage
source "subsys/logging/Kconfig.template.log_level"

endif
```

## fw/services/timeline/Kconfig
```kconfig
# SPDX-FileCopyrightText: 2026 Core Devices LLC
# SPDX-License-Identifier: Apache-2.0

config SERVICE_TIMELINE
    bool "Timeline"
    help
      Timeline service and layouts.

if SERVICE_TIMELINE

config TIMELINE_PEEK
    bool "Timeline peek (Quick View)"
    default y
    help
      Show the next timeline event over the watchface. Without it the
      peek calls are no-ops and the watchface is never obstructed.

config TIMELINE_LITE
    bool "Timeline as a plain list"
    help
      Show the timeline as a menu list of pins instead of the animated
      timeline. Select opens the same pin card. Saves about 9 KB of flash.

module = SERVICE_TIMELINE
module-str = Timeline
source "subsys/logging/Kconfig.template.log_level"

endif
```

## third_party/hal_stm32/Kconfig
```kconfig
# SPDX-FileCopyrightText: 2026 Brian Silvestri
# SPDX-License-Identifier: Apache-2.0

menuconfig HAL_STM32
    bool "STM32 Standard Peripheral Library"
    help
      Build the STM32F4xx Standard Peripheral Library.

if HAL_STM32

config HAL_STM32_STM32F205
    bool "STM32F205 SoC variant"
    default y if SOC_STM32F205
    help
      Configure the library for the STM32F205 used by the original Pebble
      (tintin). Its peripherals are the F4's (built as an STM32F40x) on a
      Cortex-M3 without an FPU.

config HAL_STM32_STM32F412
    bool "STM32F412xG SoC variant"
    help
      Configure the library for the STM32F412xG used by the Pebble 2
      (silk).

config HAL_STM32_STM32F439
    bool "STM32F439xx SoC variant"
    help
      Configure the library for the STM32F439 used by the Pebble Time
      (snowy).

endif # HAL_STM32
```
